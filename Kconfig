## Kconfig
```kconfig
DT_COMPAT_ZMK_BEHAVIOR_MOMENTARY_LAYER_LOCK := zmk,behavior-momentary-layer-lock

config ZMK_BEHAVIOR_MOMENTARY_LAYER_LOCK
    bool
    default $(dt_compat_enabled,$(DT_COMPAT_ZMK_BEHAVIOR_MOMENTARY_LAYER_LOCK))
```

## config/west.yml
```yaml
manifest:
  remotes:
    - name: zmkfirmware
      url-base: https://github.com/zmkfirmware
    - name: dhruvinsh
      url-base: https://github.com/dhruvinsh
    - name: MickiusMousius
      url-base: https://github.com/MickiusMousius
  projects:
    - name: zmk
      remote: zmkfirmware
      revision: 773dec58eaacaef4703b3e4595e50bd71f6cad3d
      import: app/west.yml
    - name: zmk-tri-state
      remote: dhruvinsh
      revision: main
      clone-depth: 1
    - name: zmk-ls0xxvcom-driver
      remote: MickiusMousius
      revision: main
      clone-depth: 1
  self:
    path: config
```

## dts/bindings/behaviors/zmk,behavior-momentary-layer-lock.yaml
```yaml
description: |
  Momentary Layer Lock - locks the topmost currently-active layer on press.
  A second tap unlocks (and deactivates) it. When no non-base layer is active,
  the configured `bindings` phandle is invoked instead.

compatible: "zmk,behavior-momentary-layer-lock"

include: zero_param.yaml

properties:
  bindings:
    type: phandle-array
    required: true
```
