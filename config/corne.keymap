/*
 * Copyright (c) 2024 Thiago Alves
 *
 * SPDX-License-Identifier: MIT
 */

// A Keyboard Keymap has 2 responsibilities in this layout system:
//
// 1. Include the correct key positions definition from the `keypos_def`
//    directory;
// 2. Define a macro function called `LAYER_ADAPTER` that receives 66 arguments
//    (one per key in the layout), and replace by the keyboard's physical layout
//    shape;
//
// After this is done, you need to import the standard layout file, so it can
// create the keymap using the macro function you previously created.

#include "keypos_def/corne.dtsi"

// Configure the under-glow LED strip
&led_strip {
  chain-length = <27>;
};

// Define the layer adapter function for the Corne
#define LAYER_ADAPTER(                                                    \
    k00, k01, k02, k03, k04, k05,           k06, k07, k08, k09, k0A, k0B, \
    k10, k11, k12, k13, k14, k15, k16, k17, k18, k19, k1A, k1B, k1C, k1D, \
    k20, k21, k22, k23, k24, k25, k26, k27, k28, k29, k2A, k2B, k2C, k2D, \
    k30, k31, k32, k33, k34, k35, k36, k37, k38, k39, k3A, k3B, k3C, k3D, \
         k40, k41, k42, k43, k44, k45, k46, k47, k48, k49, k4A, k4B       \
)                                                                         \
             k10 k11 k12 k13 k14 k15    k18 k19 k1A k1B k1C k1D           \
             k20 k21 k22 k23 k24 k25    k28 k29 k2A k2B k2C k2D           \
             k30 k31 k32 k33 k34 k35    k38 k39 k3A k3B k3C k3D           \
                         k40 k43 k44    k47 k48 k4B

#define COMBO_KEY_CAPS_WORD  <LM1 RM1>
#define COMBO_KEY_CAPS_LOCK  <LM0 RM0>

#define USE_HOLD_TAP_LAYER_BUTTONS
#define USE_HOLD_TAP_LAYER_FUNCTIONS
#define USE_HOLD_TAP_LAYER_MOUSE

// The OLED build variant ships with CONFIG_ZMK_RGB_UNDERGLOW=y (see
// corne_oled.conf). The nice!view build doesn't, but the SYS-layer RGB
// keys are harmless no-ops there. Corne never ships with switch backlight.
#define USE_RGB_UNDERGLOW

#define ZMK_POINTING_DEFAULT_MOVE_VAL 1000
#define ZMK_POINTING_DEFAULT_SCRL_VAL 35

#include "layout/standard_layout.dtsi"
